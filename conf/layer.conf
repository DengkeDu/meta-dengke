## conf/layer.conf
```bitbake
# We have a conf and classes directory, add to BBPATH
BBPATH .= ":${LAYERDIR}"

# We have recipes-* directories, add to BBFILES
BBFILES += "${LAYERDIR}/recipes-*/*/*.bb \
            ${LAYERDIR}/recipes-*/*/*.bbappend"

BBFILE_COLLECTIONS += "/buildarea1/ddu/yocto/meta-dengke"
BBFILE_PATTERN_/buildarea1/ddu/yocto/meta-dengke = "^${LAYERDIR}/"
BBFILE_PRIORITY_/buildarea1/ddu/yocto/meta-dengke = "6"
```
